## drivers/misc/mot/Kconfig
```kconfig
menu "Drivers Motorola"

config MOT_SENSORS_CLASS
	bool "Motorola sensors class (/sys/class/sensors)"
	help
	  Base class used by Motorola sensor drivers (ABOV SAR).

config MOT_ABOV_SAR
	bool "ABOV capacitive SAR sensor (astro)"
	depends on I2C
	select MOT_SENSORS_CLASS
	help
	  ABOV SAR Driver

config MOT_MMI_ANNOTATE
	bool "Motorola MMI annotate"
	help
	  Motorola debug driver. Stores text in a memory area that the bootloader keeps constant. It serves only as a dependency.

config MOT_MMI_INFO
	bool "Motorola MMI hardware info"
	select MOT_MMI_ANNOTATE
	help
	  Motorola information driver. It stores device information for userspace and writes certain data to an area accessible by the modem. Important.

config MOT_MMI_SYS_TEMP
	bool "Motorola virtual temperature driver"
	help
	  Motorola virtual temperature sensors (back and front)

endmenu
```
